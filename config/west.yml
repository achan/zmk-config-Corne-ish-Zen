## config/west.yml
```yaml
manifest:
  remotes:
    - name: zmkfirmware
      url-base: https://github.com/zmkfirmware
    - name: achan
      url-base: https://github.com/achan
  projects:
    - name: zmk-config-Corne-ish-Zen
      remote: achan
      revision: achan/feature/3x5
      import: app/west.yml
  self:
    path: config
```
